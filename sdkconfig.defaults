## sdkconfig.defaults
```kconfig
# ESP32-P4-Nano PSRAM Fix Configuration
CONFIG_IDF_TARGET="esp32p4"

# Force PSRAM detection and initialization
CONFIG_SPIRAM=y
CONFIG_SPIRAM_MODE_QUAD=y
CONFIG_SPIRAM_TYPE_ESPPSRAM32=y
CONFIG_SPIRAM_SIZE_32MB=y
CONFIG_SPIRAM_SPEED_120M=y
CONFIG_SPIRAM_BOOT_INIT=y
CONFIG_SPIRAM_IGNORE_NOTFOUND=n
CONFIG_SPIRAM_USE_MALLOC=y
CONFIG_SPIRAM_USE_CAPS_ALLOC=y
CONFIG_SPIRAM_USE_MEMMAP=y
CONFIG_SPIRAM_MEMTEST=y

# Memory allocation settings
CONFIG_SPIRAM_MALLOC_ALWAYSINTERNAL=16384
CONFIG_SPIRAM_MALLOC_RESERVE_INTERNAL=32768
CONFIG_SPIRAM_ALLOW_BSS_SEG_EXTERNAL_MEMORY=y
CONFIG_SPIRAM_ALLOW_NOINIT_SEG_EXTERNAL_MEMORY=y
CONFIG_SPIRAM_ALLOW_STACK_EXTERNAL_MEMORY=n

# BSP Display Configuration
CONFIG_BSP_DISPLAY_DSI_HX8394=y
CONFIG_BSP_DISPLAY_COLOR_FORMAT_RGB565=y
CONFIG_BSP_DSI_LANE_BITRATE_MBPS=1000

# Heap debugging (to see PSRAM in logs)
CONFIG_HEAP_TRACING_STANDALONE=y

# Stack sizes
CONFIG_ESP_MAIN_TASK_STACK_SIZE=8192
CONFIG_ESP_SYSTEM_EVENT_TASK_STACK_SIZE=4096

# Flash settings
CONFIG_ESPTOOLPY_FLASHSIZE_2MB=y
CONFIG_ESPTOOLPY_FLASHMODE_DIO=y
CONFIG_ESPTOOLPY_FLASHFREQ_80M=y

# Watchdog
CONFIG_ESP_TASK_WDT_TIMEOUT_S=15
```
